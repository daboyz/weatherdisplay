#include <WiFi.h>
#include <HTTPClient.h>
#include <ArduinoJson.h>
#include <GxEPD2_3C.h>
#include <Fonts/FreeSansBold24pt7b.h>
#include <Fonts/FreeSansBold12pt7b.h>
#include <Fonts/FreeSansBold9pt7b.h>

// Note: Adafruit GFX fonts are available in specific sizes only
// Standard sizes: 9pt, 12pt, 18pt, 24pt
// We'll use a workaround to make text appear larger

// WiFi credentials
const char* ssid = "XXXXXXXX";
const char* password = "XXXXXXXX";

// OpenWeatherMap API
const char* apiKey = "XXXXXXXXXXXXXXXXXXXXXXX";
const char* city = "XXXX";
const char* countryCode = "XX";

// Display instance for Waveshare 2.13" 3-color (250x122 pixels)
GxEPD2_3C<GxEPD2_213_Z98c, GxEPD2_213_Z98c::HEIGHT> display(GxEPD2_213_Z98c(/*CS=*/ 15, /*DC=*/ 27, /*RST=*/ 26, /*BUSY=*/ 25));

// Deep sleep time (30 minutes = 1800 seconds)
#define SLEEP_DURATION 1800

// SPI pins
#define EPD_MOSI 14
#define EPD_CLK 13

// RTC memory to store previous weather state (survives deep sleep)
RTC_DATA_ATTR int prevTemp = -999;
RTC_DATA_ATTR int prevFeelsLike = -999;
RTC_DATA_ATTR char prevIconCode[4] = "";
RTC_DATA_ATTR int prevPrecipProb = -999;
RTC_DATA_ATTR int prevWindSpeed = -999;
RTC_DATA_ATTR int prevHighTemp = -999;
RTC_DATA_ATTR int prevLowTemp = -999;
RTC_DATA_ATTR int dinoPosition = 0;

// Wind icon bitmap (24x24px) - simplified wind symbol
const unsigned char icon_wind[] PROGMEM = {
	0xff, 0xff, 0xff, 0xff, 0xff, 0xff, 0xff, 0xf0, 0x7f, 0xff, 0xe6, 0x7f, 0xff, 0xe7, 0x3f, 0xff, 
	0xef, 0x3f, 0xff, 0xfe, 0x7f, 0xe0, 0x00, 0xff, 0xff, 0xff, 0xff, 0x80, 0x00, 0x07, 0x80, 0x00, 
	0x03, 0xff, 0xff, 0xf1, 0xe0, 0x03, 0x79, 0xff, 0xe1, 0x39, 0xff, 0xf9, 0x03, 0xff, 0x39, 0x83, 
	0xff, 0x39, 0xff, 0xff, 0x83, 0xff, 0xff, 0xc7, 0xff, 0xff, 0xff, 0xff, 0xff, 0xff, 0xff, 0xff, 
	0xff, 0xff, 0xff, 0xff, 0xff, 0xff, 0xff, 0xff
};

// Dinosaur icon bitmap right (48x32px)
const unsigned char icon_dino_right[] PROGMEM = {
  0xff, 0xff, 0xff, 0xff, 0xff, 0xff, 0xff, 0xff, 0xff, 0xff, 0xff, 0xff, 
  0xff, 0xff, 0xff, 0xff, 0xf0, 0xff, 0xff, 0xff, 0xff, 0xff, 0xe0, 0x7f, 
  0xff, 0xff, 0xff, 0xff, 0xc0, 0x3f, 0xff, 0xff, 0xff, 0xff, 0xc0, 0x1f, 
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  0xff, 0xff, 0xf0, 0x03, 0x8c, 0x1f, 0xff, 0xff, 0xff, 0xff, 0x9c, 0x3f
};

// Dinosaur icon bitmap center (48x32px)
const unsigned char icon_dino_center[] PROGMEM = {
	0xff, 0xff, 0xff, 0xff, 0xff, 0xff, 0xff, 0xff, 0xff, 0xff, 0xff, 0xff, 0xff, 0xff, 0xff, 0xff, 
	0xff, 0xff, 0xc3, 0xff, 0xff, 0xff, 0xff, 0xff, 0x81, 0xff, 0xff, 0xff, 0xff, 0xff, 0xc1, 0xff, 
	0xff, 0xff, 0xff, 0xff, 0xf1, 0xff, 0xff, 0xff, 0xff, 0xff, 0xf9, 0xff, 0xff, 0xff, 0xff, 0xff, 
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	0xff, 0xff, 0xff, 0xff, 0xff, 0xff, 0xff, 0xff, 0xff, 0xff, 0xff, 0xff, 0xff, 0xff, 0xff, 0xff
};

// Dinosaur icon bitmap left (48x32px)
const unsigned char icon_dino_left[] PROGMEM = {
	0xff, 0xff, 0xff, 0xff, 0xff, 0xff, 0xff, 0xff, 0xff, 0xff, 0xff, 0xff, 0xff, 0x0f, 0xff, 0xff, 
	0xff, 0xff, 0xfe, 0x07, 0xff, 0xff, 0xff, 0xff, 0xfc, 0x03, 0xff, 0xff, 0xff, 0xff, 0xf8, 0x03, 
	0xff, 0xff, 0xff, 0xff, 0xf1, 0xfb, 0xff, 0xff, 0xff, 0xff, 0xe3, 0xff, 0xff, 0xff, 0xff, 0xff, 
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	0x00, 0x00, 0x1f, 0xff, 0xf8, 0x31, 0xc0, 0x0f, 0xff, 0xff, 0x0c, 0x39, 0xff, 0xff, 0xff, 0xff
};

// Weather icon bitmaps (60x60 pixels)
const unsigned char icon_clear[] PROGMEM = {
	0xff, 0xff, 0xff, 0xff, 0xff, 0xff, 0xff, 0xf0, 0xff, 0xff, 0xff, 0xff, 0xff, 0xff, 0xff, 0xf0, 
	0xff, 0xff, 0xff, 0xff, 0xff, 0xff, 0xff, 0xf0, 0xff, 0xff, 0xff, 0xff, 0xff, 0xff, 0xff, 0xf0, 
	0xff, 0xff, 0xff, 0xff, 0xff, 0xff, 0xff, 0xf0, 0xff, 0xff, 0xff, 0xff, 0xff, 0xff, 0xff, 0xf0, 
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	0xff, 0xff, 0xff, 0xff, 0xff, 0xff, 0xff, 0xf0, 0xff, 0xff, 0xff, 0xff, 0xff, 0xff, 0xff, 0xf0
};

const unsigned char icon_clear_night [] PROGMEM = {
	0xff, 0xff, 0xff, 0xff, 0xff, 0xff, 0xff, 0xf0, 0xff, 0xff, 0xff, 0xff, 0xff, 0xff, 0xff, 0xf0, 
	0xff, 0xff, 0xff, 0xff, 0xff, 0xff, 0xff, 0xf0, 0xff, 0xff, 0xff, 0xff, 0xff, 0xff, 0xff, 0xf0, 
	0xff, 0xff, 0xff, 0xff, 0xff, 0xff, 0xff, 0xf0, 0xff, 0xff, 0xff, 0xff, 0xff, 0xff, 0xff, 0xf0, 
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	0xff, 0xff, 0xff, 0xff, 0xff, 0xff, 0xff, 0xf0, 0xff, 0xff, 0xff, 0xff, 0xff, 0xff, 0xff, 0xf0
};

const unsigned char icon_partly_cloudy[] PROGMEM = {
	0xff, 0xff, 0xff, 0xff, 0xff, 0xff, 0xff, 0xf0, 0xff, 0xff, 0xff, 0xff, 0xff, 0xff, 0xff, 0xf0, 
	0xff, 0xff, 0xff, 0xff, 0xff, 0xff, 0xff, 0xf0, 0xff, 0xff, 0xff, 0xff, 0xff, 0xff, 0xff, 0xf0, 
	0xff, 0xff, 0xff, 0xff, 0xff, 0xff, 0xff, 0xf0, 0xff, 0xff, 0xff, 0xff, 0xff, 0xff, 0xff, 0xf0, 
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	0xff, 0xff, 0xff, 0xff, 0xff, 0xff, 0xff, 0xf0, 0xff, 0xff, 0xff, 0xff, 0xff, 0xff, 0xff, 0xf0
};

const unsigned char icon_partly_cloudy_night[] PROGMEM = {
	0xff, 0xff, 0xff, 0xff, 0xff, 0xff, 0xff, 0xf0, 0xff, 0xff, 0xff, 0xff, 0xff, 0xff, 0xff, 0xf0, 
	0xff, 0xff, 0xff, 0xff, 0xff, 0xff, 0xff, 0xf0, 0xff, 0xff, 0xff, 0xff, 0xff, 0xff, 0xff, 0xf0, 
	0xff, 0xff, 0xff, 0xff, 0xff, 0xff, 0xff, 0xf0, 0xff, 0xff, 0xff, 0xff, 0xff, 0xff, 0xff, 0xf0, 
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	0xff, 0xff, 0xff, 0xff, 0xff, 0xff, 0xff, 0xf0, 0xff, 0xff, 0xff, 0xff, 0xff, 0xff, 0xff, 0xf0
};

const unsigned char icon_mostly_cloudy [] PROGMEM = {
	0xff, 0xff, 0xff, 0xff, 0xff, 0xff, 0xff, 0xf0, 0xff, 0xff, 0xff, 0xff, 0xff, 0xff, 0xff, 0xf0, 
	0xff, 0xff, 0xff, 0xff, 0xff, 0xff, 0xff, 0xf0, 0xff, 0xff, 0xff, 0xff, 0xff, 0xff, 0xff, 0xf0, 
	0xff, 0xff, 0xff, 0xff, 0xff, 0xff, 0xff, 0xf0, 0xff, 0xff, 0xff, 0xff, 0xff, 0xff, 0xff, 0xf0, 
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	0xff, 0xff, 0xff, 0xff, 0xff, 0xff, 0xff, 0xf0, 0xff, 0xff, 0xff, 0xff, 0xff, 0xff, 0xff, 0xf0
};

const unsigned char icon_mostly_cloudy_night [] PROGMEM = {
	0xff, 0xff, 0xff, 0xff, 0xff, 0xff, 0xff, 0xf0, 0xff, 0xff, 0xff, 0xff, 0xff, 0xff, 0xff, 0xf0, 
	0xff, 0xff, 0xff, 0xff, 0xff, 0xff, 0xff, 0xf0, 0xff, 0xff, 0xff, 0xff, 0xff, 0xff, 0xff, 0xf0, 
	0xff, 0xff, 0xff, 0xff, 0xff, 0xff, 0xff, 0xf0, 0xff, 0xff, 0xff, 0xff, 0xff, 0xff, 0xff, 0xf0, 
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	0xff, 0xff, 0xff, 0xff, 0xff, 0xff, 0xff, 0xf0, 0xff, 0xff, 0xff, 0xff, 0xff, 0xff, 0xff, 0xf0
};

const unsigned char icon_cloudy[] PROGMEM = {
	0xff, 0xff, 0xff, 0xff, 0xff, 0xff, 0xff, 0xf0, 0xff, 0xff, 0xff, 0xff, 0xff, 0xff, 0xff, 0xf0, 
	0xff, 0xff, 0xff, 0xff, 0xff, 0xff, 0xff, 0xf0, 0xff, 0xff, 0xff, 0xff, 0xff, 0xff, 0xff, 0xf0, 
	0xff, 0xff, 0xff, 0xff, 0xff, 0xff, 0xff, 0xf0, 0xff, 0xff, 0xff, 0xff, 0xff, 0xff, 0xff, 0xf0, 
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	0xff, 0xff, 0xff, 0xff, 0xff, 0xff, 0xff, 0xf0, 0xff, 0xff, 0xff, 0xff, 0xff, 0xff, 0xff, 0xf0
};

const unsigned char icon_rain[] PROGMEM = {
	0xff, 0xff, 0xff, 0xff, 0xff, 0xff, 0xff, 0xf0, 0xff, 0xff, 0xff, 0xff, 0xff, 0xff, 0xff, 0xf0, 
	0xff, 0xff, 0xff, 0xff, 0xff, 0xff, 0xff, 0xf0, 0xff, 0xff, 0xff, 0xff, 0xff, 0xff, 0xff, 0xf0, 
	0xff, 0xff, 0xff, 0xff, 0xff, 0xff, 0xff, 0xf0, 0xff, 0xff, 0xff, 0xff, 0xff, 0xff, 0xff, 0xf0, 
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	0xff, 0xff, 0xff, 0xff, 0xff, 0xff, 0xff, 0xf0, 0xff, 0xff, 0xff, 0xff, 0xff, 0xff, 0xff, 0xf0
};

const unsigned char icon_snow[] PROGMEM = {
	0xff, 0xff, 0xff, 0xff, 0xff, 0xff, 0xff, 0xff, 0xff, 0xff, 0xff, 0xff, 0xff, 0xff, 0xff, 0xff, 
	0xff, 0xff, 0xff, 0xff, 0xff, 0xff, 0xff, 0xff, 0xff, 0xff, 0xff, 0xff, 0xff, 0xff, 0xff, 0xff, 
	0xff, 0xff, 0xff, 0xff, 0xff, 0xff, 0xff, 0xff, 0xff, 0xff, 0xff, 0xff, 0xff, 0xff, 0xff, 0xff, 
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	0xff, 0xff, 0xff, 0xff, 0xff, 0xff, 0xff, 0xff, 0xff, 0xff, 0xff, 0xff, 0xff, 0xff, 0xff, 0xff
};

const unsigned char icon_thunderstorm[] PROGMEM = {
	0xff, 0xff, 0xff, 0xff, 0xff, 0xff, 0xff, 0xf0, 0xff, 0xff, 0xff, 0xff, 0xff, 0xff, 0xff, 0xf0, 
	0xff, 0xff, 0xff, 0xff, 0xff, 0xff, 0xff, 0xf0, 0xff, 0xff, 0xff, 0xff, 0xff, 0xff, 0xff, 0xf0, 
	0xff, 0xff, 0xff, 0xff, 0xff, 0xff, 0xff, 0xf0, 0xff, 0xff, 0xff, 0xff, 0xff, 0xff, 0xff, 0xf0, 
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	0xff, 0xff, 0xff, 0xff, 0xff, 0xff, 0xff, 0xf0, 0xff, 0xff, 0xff, 0xff, 0xff, 0xff, 0xff, 0xf0
};

const unsigned char icon_fog[] PROGMEM = {
	0xff, 0xff, 0xff, 0xff, 0xff, 0xff, 0xff, 0xf0, 0xff, 0xff, 0xff, 0xff, 0xff, 0xff, 0xff, 0xf0, 
	0xff, 0xff, 0xff, 0xff, 0xff, 0xff, 0xff, 0xf0, 0xff, 0xff, 0xff, 0xff, 0xff, 0xff, 0xff, 0xf0, 
	0xff, 0xff, 0xff, 0xff, 0xff, 0xff, 0xff, 0xf0, 0xff, 0xff, 0xff, 0xff, 0xff, 0xff, 0xff, 0xf0, 
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	0xff, 0xff, 0xff, 0xff, 0xff, 0xff, 0xff, 0xf0, 0xff, 0xff, 0xff, 0xff, 0xff, 0xff, 0xff, 0xf0
};

// Weather data structure
struct WeatherData {
  float temp;
  float feels_like;
  String description;
  String main;
  char iconCode[4];
  float wind_speed;
  int precipProb;
  float highTemp;
  float lowTemp;
} weather;

void setup() {
  Serial.begin(115200);
  delay(1000);
  
  Serial.println("Weather Display Starting...");
  
  btStop();
  Serial.println("Bluetooth disabled");
  
  SPI.begin(EPD_CLK, -1, EPD_MOSI, 15);
  
  Serial.println("Initializing display...");
  display.init(115200, true, 2, false);
  display.setRotation(1);
  display.setTextColor(GxEPD_BLACK);
  
  connectWiFi();
  
  if (getWeatherData()) {
    int currentTemp = (int)round(weather.temp);
    int currentFeelsLike = (int)round(weather.feels_like);
    int currentWindSpeed = (int)round(weather.wind_speed * 3.6);
    
    bool weatherChanged = (currentTemp != prevTemp) || 
                         (currentFeelsLike != prevFeelsLike) ||
                         (strcmp(weather.iconCode, prevIconCode) != 0) ||
                         (weather.precipProb != prevPrecipProb) ||
                         ((currentWindSpeed >= 20) != (prevWindSpeed >= 20)) ||
                         ((int)weather.highTemp != prevHighTemp) ||
                         ((int)weather.lowTemp != prevLowTemp);
    
    if (weatherChanged) {
      Serial.println("Weather changed - updating display");
      displayWeather();
      
      prevTemp = currentTemp;
      prevFeelsLike = currentFeelsLike;
      strlcpy(prevIconCode, weather.iconCode, sizeof(prevIconCode));
      prevPrecipProb = weather.precipProb;
      prevWindSpeed = currentWindSpeed;
      prevHighTemp = (int)weather.highTemp;
      prevLowTemp = (int)weather.lowTemp;
      
      dinoPosition = (dinoPosition + 1) % 3;
    } else {
      Serial.println("Weather unchanged - skipping display update");
    }
  } else {
    displayError();
  }
  
  WiFi.disconnect(true);
  WiFi.mode(WIFI_OFF);
  
  Serial.println("Going to sleep for 30 minutes...");
  esp_sleep_enable_timer_wakeup(SLEEP_DURATION * 1000000ULL);
  esp_deep_sleep_start();
}

void loop() {
}

void connectWiFi() {
  Serial.print("Connecting to WiFi");
  WiFi.setSleep(true);
  WiFi.begin(ssid, password);
  
  int attempts = 0;
  while (WiFi.status() != WL_CONNECTED && attempts < 10) {
    delay(500);
    Serial.print(".");
    attempts++;
  }
  
  if (WiFi.status() == WL_CONNECTED) {
    Serial.println("\nConnected!");
    Serial.println(WiFi.localIP());
  } else {
    Serial.println("\nFailed to connect!");
  }
}

bool getWeatherData() {
  if (WiFi.status() != WL_CONNECTED) {
    Serial.println("WiFi not connected");
    return false;
  }
  
  HTTPClient http;
  
  String url = "http://api.openweathermap.org/data/2.5/weather?q=" + 
               String(city) + "," + String(countryCode) + 
               "&appid=" + String(apiKey) + "&units=metric";
  
  Serial.println("Fetching current weather...");
  http.begin(url);
  int httpCode = http.GET();
  
  if (httpCode != 200) {
    Serial.print("HTTP Error: ");
    Serial.println(httpCode);
    http.end();
    return false;
  }
  
  String payload = http.getString();
  DynamicJsonDocument doc(2048);
  DeserializationError error = deserializeJson(doc, payload);
  
  if (error) {
    Serial.print("JSON parsing failed: ");
    Serial.println(error.c_str());
    http.end();
    return false;
  }
  
  weather.temp = doc["main"]["temp"];
  weather.feels_like = doc["main"]["feels_like"];
  weather.description = doc["weather"][0]["description"].as<String>();
  weather.main = doc["weather"][0]["main"].as<String>();
  const char* iconCode = doc["weather"][0]["icon"];
  strlcpy(weather.iconCode, iconCode, sizeof(weather.iconCode));
  weather.wind_speed = doc["wind"]["speed"];
  
  Serial.println("Temp: " + String(weather.temp) + "°C");
  Serial.println("Feels: " + String(weather.feels_like) + "°C");
  Serial.println("Wind: " + String(weather.wind_speed) + " m/s");
  
  http.end();
  
  String forecastUrl = "http://api.openweathermap.org/data/2.5/forecast?q=" + 
                       String(city) + "," + String(countryCode) + 
                       "&appid=" + String(apiKey) + "&units=metric";
  
  Serial.println("Fetching forecast...");
  http.begin(forecastUrl);
  httpCode = http.GET();
  
  if (httpCode != 200) {
    Serial.print("Forecast Error: ");
    Serial.println(httpCode);
    http.end();
    return false;
  }
  
  payload = http.getString();
  DynamicJsonDocument forecastDoc(16384);
  error = deserializeJson(forecastDoc, payload);
  
  if (error) {
    Serial.print("Forecast JSON failed: ");
    Serial.println(error.c_str());
    http.end();
    return false;
  }
  
  weather.precipProb = (int)(forecastDoc["list"][0]["pop"].as<float>() * 100);
  Serial.println("Precip: " + String(weather.precipProb) + "%");
  
  weather.highTemp = weather.temp;
  weather.lowTemp = weather.temp;
  
  Serial.println("Calculating high/low from forecast...");
  Serial.println("Starting with current: " + String(weather.temp) + "°C");
  
  JsonArray forecastList = forecastDoc["list"].as<JsonArray>();
  int count = 0;
  
  for (JsonVariant value : forecastList) {
    if (count >= 8) break;
    
    JsonObject entry = value.as<JsonObject>();
    
    if (entry.containsKey("main")) {
      JsonObject main = entry["main"];
      if (main.containsKey("temp")) {
        float forecastTemp = main["temp"].as<float>();
        
        Serial.println("  Forecast " + String(count) + ": " + String(forecastTemp) + "°C");
        
        if (forecastTemp > weather.highTemp) {
          weather.highTemp = forecastTemp;
        }
        if (forecastTemp < weather.lowTemp) {
          weather.lowTemp = forecastTemp;
        }
        
        count++;
      }
    }
  }
  
  Serial.println("Final High: " + String(weather.highTemp) + "°C (from " + String(count) + " entries)");
  Serial.println("Final Low: " + String(weather.lowTemp) + "°C");
  
  http.end();
  return true;
}

void displayWeather() {
  Serial.println("Updating display...");
  
  display.setRotation(1);
  display.setFullWindow();
  display.firstPage();
  
  do {
    display.fillScreen(GxEPD_WHITE);
    
    // === CONFIGURABLE LAYOUT VARIABLES ===
    // Section dimensions
    int leftSectionWidth = 95;           // Left section width (was 83)
    int rightSectionStart = 95;          // Where right section begins
    int rightSectionWidth = 155;         // Right section width (250 - 95)
    
    // Left section spacing
    int tempFeelsSpacing = 26;           // Vertical spacing between temp and feels like (was ~22)
    
    // Right section row positions (baseline y for text)
    int iconBottomY = 62;                // Where weather icon ends
    int row2Offset = 20;                 // Offset from icon bottom to row 2 baseline
    int row3Offset = 20;                 // Offset from row 2 baseline to row 3 baseline
    int row2Y = iconBottomY + row2Offset;     // Wind/Precip row baseline
    int row3Y = row2Y + row3Offset;           // High/Low row baseline
    
    // Horizontal spacing in right section
    int windIconSpace = 1;               // Space between wind icon and value
    int windPrecipSpacing = 16;          // Space between wind display and precipitation
    int precipValuePercentSpacing = 3;   // Space between precipitation value and '%' sign
    int highLowSpacing = 16;             // Space between high and low temps
    int labelValueSpacing = 3;           // Space between H/L labels and their values
    
    // Dinosaur positions in left section
    int dinoLeftX = 8;                   // Leftmost position
    int dinoCenterX = (leftSectionWidth - 48) / 2;  // Centered (48 = dino width)
    int dinoRightX = leftSectionWidth - 48 - 8;     // Rightmost position
    
    // Draw vertical divider line (full height)
    display.drawLine(rightSectionStart, 0, rightSectionStart, 122, GxEPD_BLACK);
    
    // === LEFT SECTION: Temperature & Feels Like ===
    int tempValue = (int)round(weather.temp);
    if (tempValue > 0) {
      display.setTextColor(GxEPD_RED);
    } else {
      display.setTextColor(GxEPD_BLACK);
    }
    
    display.setFont(&FreeSansBold24pt7b);
    String tempStr = String(tempValue) + "°";
    
    int16_t x1, y1;
    uint16_t w, h;
    display.getTextBounds(tempStr, 0, 0, &x1, &y1, &w, &h);
    int tempX = (leftSectionWidth - w) / 2 - x1;
    int tempY = 48;
    display.setCursor(tempX, tempY);
    display.print(tempStr);
    
    // Feels like (with increased spacing)
    display.setTextColor(GxEPD_BLACK);
    display.setFont(&FreeSansBold12pt7b);
    int feelsValue = (int)round(weather.feels_like);
    String feelsStr = String(feelsValue) + "°";
    
    display.getTextBounds(feelsStr, 0, 0, &x1, &y1, &w, &h);
    int feelsX = (leftSectionWidth - w) / 2 - x1;
    int feelsY = tempY + tempFeelsSpacing;
    display.setCursor(feelsX, feelsY);
    display.print(feelsStr);
    
    // === RIGHT SECTION: Weather Icon (top) ===
    int iconSize = 60;
    int iconX = rightSectionStart + (rightSectionWidth - iconSize) / 2;
    int iconY = 2;
    drawWeatherIcon(weather.iconCode, iconX, iconY);
    
    // === RIGHT SECTION: Row 2 - Wind & Precipitation ===
    display.setFont(&FreeSansBold9pt7b);
    int windSpeed = (int)round(weather.wind_speed * 3.6);  // Convert m/s to km/h
    String windStr = String(windSpeed);
    String precipValue = String(weather.precipProb);
    String precipPercent = "%";
    
    display.getTextBounds(windStr, 0, 0, &x1, &y1, &w, &h);
    int windValueW = w;
    display.getTextBounds(precipValue, 0, 0, &x1, &y1, &w, &h);
    int precipValueW = w;
    display.getTextBounds(precipPercent, 0, 0, &x1, &y1, &w, &h);
    int precipPercentW = w;
    
    int windIconW = 24;
    
    // Total width: icon + space + windValue + space + precipValue + space + %
    int row2TotalWidth = windIconW + windIconSpace + windValueW + windPrecipSpacing + 
                         precipValueW + precipValuePercentSpacing + precipPercentW;
    
    display.getTextBounds(windStr, 0, 0, &x1, &y1, &w, &h);
    int startX = rightSectionStart + (rightSectionWidth - row2TotalWidth) / 2 - x1;
    
    // Wind icon
    display.drawBitmap(startX, row2Y - 16, icon_wind, 24, 24, GxEPD_WHITE, GxEPD_BLACK);
    
    // Wind speed value (red if >20 km/h, black otherwise)
    if (windSpeed > 20) {
      display.setTextColor(GxEPD_RED);
    } else {
      display.setTextColor(GxEPD_BLACK);
    }
    display.setCursor(startX + windIconW + windIconSpace, row2Y);
    display.print(windStr);
    
    // Precipitation value
    display.setTextColor(GxEPD_BLACK);
    int precipX = startX + windIconW + windIconSpace + windValueW + windPrecipSpacing;
    display.setCursor(precipX, row2Y);
    display.print(precipValue);
    
    // Precipitation percent sign
    display.setCursor(precipX + precipValueW + precipValuePercentSpacing, row2Y);
    display.print(precipPercent);
    
    // === RIGHT SECTION: Row 3 - High & Low ===
    int highTemp = (int)weather.highTemp;
    int lowTemp = (int)weather.lowTemp;
    String highStr = String(highTemp);
    String lowStr = String(lowTemp);
    
    display.getTextBounds(highStr, 0, 0, &x1, &y1, &w, &h);
    int highW = w;
    display.getTextBounds(lowStr, 0, 0, &x1, &y1, &w, &h);
    int lowW = w;
    display.getTextBounds("H", 0, 0, &x1, &y1, &w, &h);
    int hLabelW = w;
    display.getTextBounds("L", 0, 0, &x1, &y1, &w, &h);
    int lLabelW = w;
    
    // Total width: H + space + highValue + space + L + space + lowValue
    int row3TotalWidth = hLabelW + labelValueSpacing + highW + highLowSpacing + 
                         lLabelW + labelValueSpacing + lowW;
    
    display.getTextBounds(highStr, 0, 0, &x1, &y1, &w, &h);
    startX = rightSectionStart + (rightSectionWidth - row3TotalWidth) / 2 - x1;
    
    // High temp
    display.setTextColor(GxEPD_BLACK);
    display.setCursor(startX, row3Y);
    display.print("H");
    
    if (highTemp > 0) {
      display.setTextColor(GxEPD_RED);
    }
    display.setCursor(startX + hLabelW + labelValueSpacing, row3Y);
    display.print(highStr);
    
    // Low temp
    display.setTextColor(GxEPD_BLACK);
    int lowLabelX = startX + hLabelW + labelValueSpacing + highW + highLowSpacing;
    display.setCursor(lowLabelX, row3Y);
    display.print("L");
    
    if (lowTemp > 0) {
      display.setTextColor(GxEPD_RED);
    }
    display.setCursor(lowLabelX + lLabelW + labelValueSpacing, row3Y);
    display.print(lowStr);
    
    // === LEFT SECTION: Dinosaur (bottom) ===
    int dinoY = 88;
    int dinoX;
    const unsigned char* dinoIcon = nullptr;
    
    switch(dinoPosition) {
      case 0: dinoX = dinoLeftX; dinoIcon = icon_dino_left; break;
      case 1: dinoX = dinoCenterX; dinoIcon = icon_dino_center; break;
      case 2: dinoX = dinoRightX; dinoIcon = icon_dino_right; break;
      default: dinoX = dinoCenterX; dinoIcon = icon_dino_center;
    }
    
    display.drawBitmap(dinoX, dinoY, dinoIcon, 48, 32, GxEPD_WHITE, GxEPD_BLACK);
    
  } while (display.nextPage());
  
  Serial.println("Display complete");
  display.hibernate();
}

void drawWeatherIcon(const char* iconCode, int x, int y) {
  const unsigned char* iconBitmap = nullptr;
  
  // Thunderstorm (11d, 11n)
  if (strncmp(iconCode, "11", 2) == 0) {
    iconBitmap = icon_thunderstorm;
  }
  // Rain/Drizzle (09d, 09n, 10d, 10n)
  else if (strncmp(iconCode, "09", 2) == 0 || strncmp(iconCode, "10", 2) == 0) {
    iconBitmap = icon_rain;
  }
  // Snow (13d, 13n)
  else if (strncmp(iconCode, "13", 2) == 0) {
    iconBitmap = icon_snow;
  }
  // Mist/Fog (50d, 50n)
  else if (strncmp(iconCode, "50", 2) == 0) {
    iconBitmap = icon_fog;
  }
  // Clear sky - day (01d)
  else if (strcmp(iconCode, "01d") == 0) {
    iconBitmap = icon_clear;
  }
  // Clear sky - night (01n)
  else if (strcmp(iconCode, "01n") == 0) {
    iconBitmap = icon_clear_night;
  }
  // Few clouds - day (02d)
  else if (strcmp(iconCode, "02d") == 0) {
    iconBitmap = icon_partly_cloudy;
  }
  // Few clouds - night (02n)
  else if (strcmp(iconCode, "02n") == 0) {
    iconBitmap = icon_partly_cloudy_night;
  }
  // Scattered clouds - day (03d) - 25-50% coverage
  else if (strcmp(iconCode, "03d") == 0) {
    iconBitmap = icon_mostly_cloudy;
  }
  // Scattered clouds - night (03n) - 25-50% coverage
  else if (strcmp(iconCode, "03n") == 0) {
    iconBitmap = icon_mostly_cloudy_night;
  }
  // Broken/Overcast clouds (04d, 04n) - 51-100% coverage
  else if (strncmp(iconCode, "04", 2) == 0) {
    iconBitmap = icon_cloudy;
  }
  
  if (iconBitmap != nullptr) {
    display.drawBitmap(x, y, iconBitmap, 60, 60, GxEPD_WHITE, GxEPD_BLACK);
  }
}

void displayError() {
  Serial.println("Displaying error...");
  
  display.setFullWindow();
  display.firstPage();
  
  do {
    display.fillScreen(GxEPD_WHITE);
    display.setTextColor(GxEPD_RED);
    display.setFont(&FreeSansBold12pt7b);
    display.setCursor(10, 40);
    display.println("Error!");
    display.setFont(&FreeSansBold9pt7b);
    display.setCursor(10, 70);
    display.println("Check WiFi");
  } while (display.nextPage());
  
  display.hibernate();
}